## Kconfig
```kconfig
# Copyright (c) 2025 Titouan Christophe
# SPDX-License-Identifier: Apache-2.0

rsource "drivers/seesaw/Kconfig"
```

## drivers/seesaw/Kconfig
```kconfig
config SEESAW
	bool "Adafruit Seesaw module"
	default y
	depends on I2C && DT_HAS_ADAFRUIT_SEESAW_ENABLED
	help
	  Enable support for Adafruit seesaw module (core driver)

if SEESAW

module = SEESAW
module-str = seesaw
source "subsys/logging/Kconfig.template.log_config"

config SEESAW_GPIO
	bool "Seesaw GPIO"
	default y
	depends on DT_HAS_ADAFRUIT_SEESAW_GPIO_ENABLED
	depends on GPIO
	help
	  Enable support for Adafruit Seesaw gpio

config SEESAW_PWM
	bool "Seesaw PWM"
	default y
	depends on DT_HAS_ADAFRUIT_SEESAW_PWM_ENABLED
	depends on PWM
	help
	  Enable support for Adafruit Seesaw PWM

config SEESAW_INPUT_KEYPAD
	bool "Seesaw keypad input"
	default y
	depends on DT_HAS_ADAFRUIT_SEESAW_KEYPAD_ENABLED
	depends on INPUT
	help
	  Enable support for Adafruit Seesaw keypad input

if SEESAW_INPUT_KEYPAD

config SEESAW_INPUT_KEYPAD_POLL_INTERVAL
	int "Event poll interval (ms)"
	default 25

endif

config SEESAW_NEOPIXEL
	bool "Seesaw neopixel leds"
	default y
	depends on DT_HAS_ADAFRUIT_SEESAW_NEOPIXEL_ENABLED
	depends on LED

config SEESAW_EEPROM
	bool "Seesaw EEPROM"
	default y
	depends on DT_HAS_ADAFRUIT_SEESAW_EEPROM_ENABLED
	depends on EEPROM

endif
```

## dts/bindings/adafruit,seesaw-eeprom.yaml
```yaml
# Copyright (c) 2025 Titouan Christophe
# SPDX-License-Identifier: Apache-2.0

description: Adafruit Seesaw eeprom

compatible: "adafruit,seesaw-eeprom"

properties:
  size:
    required: true
    type: int
    description: |
      Size of the eeprom, in Bytes
```

## dts/bindings/adafruit,seesaw-gpio.yaml
```yaml
# Copyright (c) 2025 Titouan Christophe
# SPDX-License-Identifier: Apache-2.0

description: Adafruit Seesaw gpio

compatible: "adafruit,seesaw-gpio"

include: [gpio-controller.yaml]

properties:
  "#gpio-cells":
    const: 2

gpio-cells:
  - pin
  - flags
```

## dts/bindings/adafruit,seesaw-keypad.yaml
```yaml
# Copyright (c) 2025 Titouan Christophe
# SPDX-License-Identifier: Apache-2.0

description: Adafruit Seesaw keypad input

compatible: "adafruit,seesaw-keypad"
```

## dts/bindings/adafruit,seesaw-neopixel.yaml
```yaml
# Copyright (c) 2025 Titouan Christophe
# SPDX-License-Identifier: Apache-2.0

description: Adafruit Seesaw neopixel output

compatible: "adafruit,seesaw-neopixel"

include: [led-strip.yaml]

properties:
  output-pin:
    required: true
    type: int
    description: |
      Neopixel output pin number
```

## dts/bindings/adafruit,seesaw-pwm.yaml
```yaml
# Copyright (c) 2025 Titouan Christophe
# SPDX-License-Identifier: Apache-2.0

description: Adafruit Seesaw PWM

compatible: "adafruit,seesaw-pwm"

include: [pwm-controller.yaml]

properties:
  "#pwm-cells":
    const: 3
    description: |
      Number of items to expect in a PWM
      - channel
      - period
      - flags

pwm-cells:
  - channel
  - period
  - flags
```

## dts/bindings/adafruit,seesaw.yaml
```yaml
# Copyright (c) 2025 Titouan Christophe
# SPDX-License-Identifier: Apache-2.0

description: Adafruit Seesaw module

compatible: "adafruit,seesaw"

include: [i2c-device.yaml]
```

## west.yml
```yaml
# Copyright (c) 2025 Titouan Christophe
# SPDX-License-Identifier: Apache-2.0

manifest:
  remotes:
    - name: zephyrproject-rtos
      url-base: https://github.com/zephyrproject-rtos

  projects:
    - name: zephyr
      remote: zephyrproject-rtos
      revision: main
      clone-depth: 1
      import:
        # By using name-allowlist we can clone only the modules that are
        # strictly needed by the application.
        name-allowlist:
          - cmsis      # required by the ARM port
          - hal_stm32  # required by the nucleo_f302r8 board (STM32 based)
```
