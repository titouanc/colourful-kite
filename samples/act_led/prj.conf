## CMakeLists.txt
```
# Copyright (c) 2025 Titouan Christophe
# SPDX-License-Identifier: Apache-2.0

cmake_minimum_required(VERSION 3.13.1)
find_package(Zephyr REQUIRED HINTS $ENV{ZEPHYR_BASE})

project(act_led LANGUAGES C)

target_sources(app PRIVATE src/main.c)
```

## prj.conf
```kconfig
CONFIG_I2C=y
CONFIG_GPIO=y
```

## app.overlay
```dts
seesaw_i2c: &arduino_i2c {};
#include <samples/seesaw-attiny817.dtsi>

&seesaw_gpio {
    status = "okay";
};
```

## src/main.c
```c
#include <zephyr/kernel.h>
#include <zephyr/drivers/gpio.h>

const struct gpio_dt_spec led = GPIO_DT_SPEC_GET(DT_NODELABEL(seesaw_red_led), gpios);

int main()
{
    bool on = false;
    printk("Sample seesaw_act_led\n");

    if (! device_is_ready(led.port)) {
        printk("Device is not ready !\n");
        return -1;
    }

    if (gpio_pin_configure_dt(&led, GPIO_OUTPUT)) {
        printk("Unable to configure as output");
        return -1;
    }

    while (1) {
        on = !on;
        gpio_pin_set_dt(&led, on);
        k_sleep(K_MSEC(500));
    }
}
```
