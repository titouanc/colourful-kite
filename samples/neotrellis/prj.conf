## CMakeLists.txt
```
# Copyright (c) 2025 Titouan Christophe
# SPDX-License-Identifier: Apache-2.0

cmake_minimum_required(VERSION 3.13.1)
find_package(Zephyr REQUIRED HINTS $ENV{ZEPHYR_BASE})

project(neotrellis LANGUAGES C)

target_sources(app PRIVATE src/main.c)
```

## prj.conf
```kconfig
CONFIG_I2C=y
CONFIG_INPUT=y
CONFIG_LED=y
```

## app.overlay
```dts
seesaw_i2c: &arduino_i2c {};
#include <samples/neotrellis.dtsi>

&neotrellis_keypad {
    status = "okay";
};

&neotrellis_leds {
    status = "okay";
};
```

## src/main.c
```c
#include <zephyr/drivers/led.h>
#include <zephyr/input/input.h>

static const struct device *leds = DEVICE_DT_GET(DT_NODELABEL(neotrellis_leds));

static void key_event(struct input_event *evt, void *user_data)
{
    uint8_t row = evt->code >> 3;
    uint8_t col = evt->code & 0x07;
    uint8_t lednum = 4*row + col;

    if (evt->value) {
        led_on(leds, lednum);
    } else {
        led_off(leds, lednum);
    }
}

#define NEOTRELLIS_KEYPAD DEVICE_DT_GET(DT_NODELABEL(neotrellis_keypad))
INPUT_CALLBACK_DEFINE(NEOTRELLIS_KEYPAD, key_event, NULL);

int main()
{
    printk("Sample seesaw_neotrellis\n");
    return 0;
}
```
